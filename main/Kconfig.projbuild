## main/Kconfig.projbuild
```kconfig
menu "Example Configuration"

    config ESP_WIFI_SSID
        string "WiFi SSID"
        default ""
        help
            SSID (network name) for the example to connect to.
    config ESP_WIFI_PASSWORD
        string "WiFi Password"
        default ""
        help
            WiFi password (WPA or WPA2) for the example to use.
    config OPENAI_API_KEY
        string "OpenAI Key"
        default ""
        help
            OpenAI api key for the example to use.
    config OPENAI_MODEL
        string "OpenAI model"
        default "gpt-3.5-turbo"
        help
            OpenAI model from https://platform.openai.com/docs/models/gpt-3-5
    config VOICE_ID
        string "Speaker Id"
        default "erKgR0s8Y67t4iiHuA9R"
        help
            speaker id from https://help.elevenlabs.io/hc/en-us/articles/14599760033937-How-do-I-find-my-voices-ID-of-my-voices-via-the-website-and-through-the-API
    config VOLUME_LEVEL
        int "volume level"
        default "90"
        range 1 100
        help
            speaker volume
    config MAX_TOKEN
        int "Chat GPT Response Token"
        default 500
        range 1 2048
        help
            Chat GPT response token between 1 - 2048.            
    config ESP_MAXIMUM_RETRY
        int "Maximum retry"
        default 5
        help
            Set the Maximum retry to avoid station reconnecting to the AP unlimited when the AP is really inexistent.
    config XI_API_KEY
        string "ElevenLabs Key"
        default "2d264a30c0f0a5062bce64676df73603"
        help
           ElevenLabs api key for the example to use.
endmenu
```
